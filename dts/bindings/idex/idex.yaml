## dts/bindings/idex/idex.yaml
```yaml
description: IDEX Fingerprint sensor

compatible: "idex"

include: [spi-device.yaml]

properties:
    idex-stby-gpios:
      type: phandle-array
      required: true
      description: STANDBY pin.

    idex-rdy-gpios:
      type: phandle-array
      required: true
      description: READY pin.
```

## dts/bindings/sensor/maxim,max77734.yaml
```yaml
description: Maxim MAX77734 PMIC

compatible: "maxim,max77734"

include: i2c-device.yaml

properties:
    int-gpios:
      type: phandle-array
      required: false

    thm:
      type: int
      required: false
      default: 0x0F
      description: |
        JEITA Temperature Voltage Thresholds

    vchgin-min-mV:
      type: int
      required: false
      default: 4000
      description: |
        The Minimum CHGIN Regulation Voltage (VCHGIN-MIN).
        This 3-bit configuration is a linear transfer function that starts at 4000mV
        and ends at 4700mV, with 100mV increments.

    ichgin-lim-mA:
      type: int
      required: false
      default: 95
      description: |
        CHGIN Input Current Limit (ICHGIN-LIM).
        This 3-bit configuration is a linear transfer function that starts at 95mA
        and ends at 475mA, with 95mA increments.

    i-pq:
      type: int
      required: false
      default: 10
      description: |
        Prequalification charge current(IPQ) as a percentage of IFAST-CHG.

    chg-pq:
      type: int
      required: false
      default: 3000
      description: |
        Battery Prequalification Voltage Threshold (VPQ).
        This 3-bit configuration is a linear transfer function that starts at 2300mV
        and ends at 3000mV, with 100mV increments.

    i-term:
      type: int
      required: false
      default: 150
      description: |
        Battery Charge Termination Current (ITERM) as a per-mille of IFAST-CHG.

    t-topoff:
      type: int
      required: false
      default: 0
      description: |
        Sets the Top-Off Timer Value (tTO).
        This 3-bit configuration is a linear transfer function that starts at 0 minutes
        and ends at 35 minutes, with 5 minute increments.

    tj-reg:
      type: int
      required: false
      default: 60
      description: |
        Sets the Die Junction Temperature Regulatoin Point (TJ-REG).
        This 3-bit configuration is a linear transfer function that starts at 60 Celcius
        and ends at 100 Celcius, with 10 Celcius increments.

    vsys-reg-mV:
      type: int
      required: false
      default: 4500
      description: |
        System Voltage Regulation Point While CHGIN is Valid (VSYS-REG).
        This 5-bit configuration is a linear transfer function that starts at 4100mV
        and ends at 4800mV, with 25mV increments.

    chg-cc-uA:
      type: int
      required: false
      default: 15000
      description: |
        Fast-Charge Constant Current Value (IFAST-CHG).
        This 6-bit configuration is a linear transfer function that starts at 7500uA and
        ends at 300000uA, with 7500uA increments

    chg-max-cc-uA:
      type: int
      required: false
      default: 15000
      description: |
        Max fast-Charge Constant Current Value (IFAST-CHG).
        This 6-bit configuration is a linear transfer function that starts at 7500uA and
        ends at 300000uA, with 7500uA increments

    t-fast-chg-hr:
      type: int
      required: false
      default: 3
      description: |
        Fast-Charge Safety Timer (tFC).
        This 2-bit configuration is a linear transfer function that starts at 3 hours
        and ends at 7 hours, with 2 hour increments.

    t-fast-chg-disabled:
      type: boolean
      required: false
      description: |
        Disable Fast-Charge Safety Timer (tFC). This option overrides t-fast-chg-hr.

    chg-cc-jeita-uA:
      type: int
      required: false
      default: 15000
      description: |
        IFAST-CHG_JEITA for when the battery is either cool or warm as defined
        by the TCOOL and TWARM temperature thresholds. This register is a don't
        care if the battery temperature is normal or if THM_EN = 0.
        This 6-bit configuration is a linear transfer function that starts at 7500uA
        and ends at 300000uA, with 7500uA increments.

    thm-en:
      type: boolean
      required: false
      description: |
        Thermistor Enable. Setting this bit causes the charger to enable the thermistor bias
        (TBIAS) and continuously monitor battery temperature. Does not collide with
        MUX_SEL[3:0] settings 0x7 or 0x8.

    chg-cv-mV:
      type: int
      required: false
      default: 3600
      description: |
        Sets fast-charge battery regulation voltage (VFAST-CHG). Internal logic
        clamps the maximum VFAST-CHG value to 200mV less than VSYS-REG.
        This 6-bit configuration is a linear transfer function that starts at 3600mV
        and ends at 4600mV, with 25mV increments.

    usbs:
      type: boolean
      required: false
      description: |
        Setting this bit places CHGIN in USB suspend mode. CHGIN can not draw
        power from an external source while in USB suspend mode.

    chg-cv-jeita-mV:
      type: int
      required: false
      default: 3600
      description: |
        Sets VFAST-CHG_JEITA for when the battery is either cool or warm as defined
        by the TCOOL and TWARM temperature thresholds. This register is a don't care
        if the battery temperature is normal or if THM_EN = 0.
        Internal logic clamps the maximum VFAST-CHG_JEITA value to 200mV less than VSYS-REG.
        This 6-bit configuration is a linear transfer function that starts at 3600mV and ends at
        4600mV, with 25mV increments.

    imon-dischg-scale:
      type: int
      required: false
      default: 0x0F
      description: |
        Selects the battery discharge current full-scale current value.
        This 4-bit configuration starts at 8200uA and ends at 300000uA.

    ldo-voltage-mV:
        type: int
        required: false
        default: 3300
        description: |
          LDO Target Regulation Voltage (VLDO-REG).
          This 7-bit configuration is a linear transfer function that
          starts at 800mV and ends at 3975mV, with 25mV increments.

    t-mrst-s:
        type: int
        required: false
        default: 8
        enum:
          - 8
          - 16
        description: |
          Sets the Manual Reset Time (tMRST).

    io-channels:
      required: false
      description: |
        IO channel associated with the AMUX voltage

    io-channel-names:
      required: false
      description: name of each ADC channel
```

## offpad/Kconfig
```kconfig
config HAS_STPAY_VDD_GPIO
	bool "Has STPAY Vdd GPIO"
	default n

config HAS_EXTERNAL_LDO
	bool "Has external LDO"
	default n

config SC_WT
	int "SmartCard WT parameter value"
	default 983

config SC_ETU
	int "SmartCard ETU parameter value"
	default 245750
```

## offpad/Kconfig.offpad
```kconfig
# SPDX-License-Identifier: Apache-2.0

config BOARD_OFFPAD
	select SOC_STM32WB55XX
```

## offpad/board.yml
```yaml
board:
  name: offpad
  vendor: arm
  socs:
    - name: stm32wb55xx
  revision:
    format: custom
    default: MP2_V1
    exact: true
    revisions:
    - name: MP1_V2
    - name: MP1_V3
    - name: MP1_V4
    - name: MP1_V5
    - name: MP2_V1
```

## offpad/dts/bindings/uc8156/uc8156.yaml
```yaml
# Copyright (c) 2022, Benjamin Björnsson <benjamin.bjornsson@gmail.com>.
# SPDX-License-Identifier: Apache-2.0

description: UC8156 EPD display controller

compatible: "uc8156"

include: [spi-device.yaml, display-controller.yaml]

properties:
    reset-gpios:
      type: phandle-array
      required: true
      description: RESET pin.

        The RESET pin of GD7965 is active low.
        If connected directly the MCU pin should be configured
        as active low.

    busy-gpios:
      type: phandle-array
      required: true
      description: BUSY pin.

        The BUSY pin of GD7965 is active low.
        If connected directly the MCU pin should be configured
        as active low.
```

## offpad/offpad_MP2_V1_defconfig
```kconfig
CONFIG_BT_DIS_MODEL="MP2"
CONFIG_BT_DIS_HW_REV_STR="V1"
CONFIG_BT_DIS_FW_REV=y
CONFIG_BT_DIS_HW_REV=y
CONFIG_BT_DIS_SW_REV=n

CONFIG_HAS_EXTERNAL_LDO=y

# USB HID related
CONFIG_USB_DEVICE_STACK=y
CONFIG_USB_DEVICE_HID=y
CONFIG_USB_DEVICE_MANUFACTURER="PONE Biometrics"
CONFIG_USB_DEVICE_PRODUCT="OFFPAD+"
CONFIG_USB_DEVICE_VID=0x37ce
CONFIG_USB_DEVICE_PID=0x0202
CONFIG_USB_HID_BOOT_PROTOCOL=y
CONFIG_USB_DEVICE_INITIALIZE_AT_BOOT=n
CONFIG_SYS_CLOCK_HW_CYCLES_PER_SEC=64000000

# USB HID settings for bidirectional USB-HID communication
CONFIG_USB_DEVICE_SOF=y
CONFIG_USB_HID_REPORTS=1
CONFIG_ENABLE_HID_INT_OUT_EP=y

# Do not display serial number in USB descriptor
CONFIG_USB_DEVICE_SN=""

# USB related logging
CONFIG_USB_DRIVER_LOG_LEVEL_ERR=y
CONFIG_USB_DEVICE_LOG_LEVEL_ERR=y

#Display type
#CONFIG_SSD1681=y
```

## offpad/offpad_defconfig
```kconfig
# enable uart driver
CONFIG_SERIAL=y

# enable GPIO
CONFIG_GPIO=y

# enable clocks
CONFIG_CLOCK_CONTROL=y

# console
CONFIG_CONSOLE=y
CONFIG_UART_CONSOLE=y

# Enable MPU
CONFIG_ARM_MPU=y

# Enable HW stack protection
CONFIG_HW_STACK_PROTECTION=y

# enable pin controller
CONFIG_PINCTRL=y

# Enable ADC
CONFIG_ADC=y

# Configure HID to interrupt on 64 bytes of data, otherwise our app will be confused
CONFIG_HID_INTERRUPT_EP_MPS=64
```

## west-manifest/west.yml
```yaml
manifest:
  remotes:
    - name: zephyrproject
      url-base: https://github.com/zephyrproject-rtos
  projects:
    - name: zephyr
      repo-path: zephyr
      remote: zephyrproject
      revision: v3.7.1
      clone-depth: 1
      import:
        path-prefix: external
    - name: secp256k1-frost
      path: external/modules/crypto/secp256k1-frost
      url: https://github.com/bancaditalia/secp256k1-frost
      revision: frost
```
