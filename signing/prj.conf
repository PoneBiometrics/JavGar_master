## CMakeLists.txt
```
cmake_minimum_required(VERSION 3.20)
find_package(Zephyr REQUIRED HINTS $ENV{ZEPHYR_BASE})
project(signing)

file(GLOB_RECURSE SECP256K1_SOURCES
  modules/secp256k1/src/*.c
  # modules/secp256k1/src/modules/frost/*.c
)

# Sources
target_sources(app PRIVATE
  src/main.c
  ${SECP256K1_SOURCES}
)

# Headers
zephyr_include_directories(
  modules/secp256k1/include
  modules/secp256k1/src/*.h
  # modules/secp256k1/src/modules/frost*.h
)

# Required compiler definitions for FROST
zephyr_compile_definitions(
    ENABLE_MODULE_FROST=1
    USE_BASIC_CONFIG=1
)

target_compile_options(app PRIVATE -Wno-unused-function)
add_definitions(-D__ZEPHYR__)
```

## prj.conf
```kconfig
# To make the logs work some changes were made to the dts of the board
# &rng {
#     status = "okay";
# 	  clocks = <&rcc STM32_CLOCK_BUS_AHB2 0x00000040>, 
#              <&rcc STM32_SRC_MSI CLK48_SEL(0)>;
# };

CONFIG_LOG=y
CONFIG_LOG_MODE_IMMEDIATE=y
CONFIG_LOG_DEFAULT_LEVEL=3
CONFIG_LOG_BACKEND_UART=y
CONFIG_LOG_BACKEND_UART_AUTOSTART=y

# CONFIG_ENTROPY_STM32_RNG=y
CONFIG_TEST_RANDOM_GENERATOR=y
# CONFIG_HARDWARE_DEVICE_CS_GENERATOR=y
# CONFIG_CTR_DRBG_CSPRNG_GENERATOR=y
# CONFIG_MBEDTLS=y
# CONFIG_MBEDTLS_CIPHER_AES_ENABLED=y
# CONFIG_ENTROPY_GENERATOR=y 
# CONFIG_ENTROPY_DEVICE_RANDOM_GENERATOR=y

CONFIG_NEWLIB_LIBC=y 
CONFIG_SHELL=y
CONFIG_MAIN_STACK_SIZE=70000

CONFIG_UART_CONSOLE=y
CONFIG_CONSOLE=y
CONFIG_UART_LINE_CTRL=y
CONFIG_UART_INTERRUPT_DRIVEN=y
CONFIG_UART_USE_RUNTIME_CONFIGURE=y
CONFIG_LOG_PRINTK=y
CONFIG_STDOUT_CONSOLE=y
```

## src/main.c
```c
#include <stdio.h>
#include <assert.h>
#include <string.h>
#include <stdint.h>
#include <zephyr/logging/log.h>

#include <secp256k1.h>
#include <secp256k1_frost.h>

#include "examples_util.h"

#define EXAMPLE_MAX_PARTICIPANTS 3
#define EXAMPLE_MIN_PARTICIPANTS 2

LOG_MODULE_REGISTER(uart_receiver, LOG_LEVEL_INF);

static void log_hex(const char *label, const uint8_t *data, size_t len) {
    char hexstr[2 * len + 1];

    for (size_t i = 0; i < len; i++) {
        snprintf(&hexstr[i * 2], 3, "%02x", data[i]);
    }

    LOG_INF("%s: 0x%s", label, hexstr);
}

int main(void) {

    LOG_INF("Starting");

    unsigned char msg[12] = "Hello World!";
    unsigned char msg_hash[32];
    unsigned char tag[14] = "frost_protocol";
    uint32_t index;
    unsigned char binding_seed[32] = {0};
    unsigned char hiding_seed[32] = {0};
    unsigned char signature[64];
    int is_signature_valid;
    int return_val;

    /* secp256k1 context used to sign and verify signatures */
    secp256k1_context *sign_verify_ctx;

    /* This example uses a centralized trusted dealer to generate keys. Alternatively,
     * FROST provides functions to run distributed key generation. See modules/frost/tests_impl.h */
    secp256k1_frost_vss_commitments *dealer_commitments;
    secp256k1_frost_keygen_secret_share shares_by_participant[3];
    /* keypairs stores private and public keys for each participant */
    secp256k1_frost_keypair keypairs[EXAMPLE_MAX_PARTICIPANTS];
    /* public_keys stores only public keys for each participant (this info can/should be shared among signers) */
    secp256k1_frost_pubkey public_keys[EXAMPLE_MAX_PARTICIPANTS];
    secp256k1_frost_signature_share signature_shares[EXAMPLE_MAX_PARTICIPANTS];
    secp256k1_frost_nonce *nonces[EXAMPLE_MAX_PARTICIPANTS];
    secp256k1_frost_nonce_commitment signing_commitments[EXAMPLE_MAX_PARTICIPANTS];

    /*** Initialization ***/
    sign_verify_ctx = secp256k1_context_create(SECP256K1_CONTEXT_SIGN | SECP256K1_CONTEXT_VERIFY);
    LOG_INF("Context created");

    /*** Key Generation ***/
    LOG_INF("Starting Key Generation");
    dealer_commitments = secp256k1_frost_vss_commitments_create(2);
    LOG_INF("Commitments created");
    return_val = secp256k1_frost_keygen_with_dealer(sign_verify_ctx, dealer_commitments,
                                                shares_by_participant, keypairs,
                                                EXAMPLE_MAX_PARTICIPANTS, EXAMPLE_MIN_PARTICIPANTS); //Problem here
    LOG_INF("Values created");
    assert(return_val == 1);

    /* Extracting public_keys from keypair. This operation is intended to be executed by each signer.  */
    for (index = 0; index < EXAMPLE_MIN_PARTICIPANTS; index++) {
        LOG_INF("Participant #%d", index);
        secp256k1_frost_pubkey_from_keypair(&public_keys[index], &keypairs[index]);
        log_hex("Secret Key", keypairs[index].secret, sizeof(keypairs[index].secret));
        log_hex("Public Key", keypairs[index].public_keys.public_key, sizeof(keypairs[index].public_keys.public_key));
    }

    log_hex("Group Public Key", keypairs[0].public_keys.group_public_key, sizeof(keypairs[0].public_keys.group_public_key));

    /*** Signing ***/
    /* In FROST, each signer needs to generate a nonce for each signature to compute. A nonce commitment is
     * exchanged among signers to prevent forgery of signature aggregations. */

    /* Nonce:
     * Participants to the signing process generate a new nonce and share the related commitment */
    for (index = 0; index < EXAMPLE_MIN_PARTICIPANTS; index++) {

        /* Generate 32 bytes of randomness to use for computing the nonce. */
        if (!fill_random(binding_seed, sizeof(binding_seed))) {
            LOG_INF("Failed to generate binding_seed");
            return 1;
        }
        if (!fill_random(hiding_seed, sizeof(hiding_seed))) {
            LOG_INF("Failed to generate hiding_seed");
            return 1;
        }

        /* Create the nonce (the function already computes its commitment) */
        nonces[index] = secp256k1_frost_nonce_create(sign_verify_ctx, &keypairs[index],
                                                     binding_seed, hiding_seed);

        log_hex("Nonce hiding commitment", nonces[index]->commitments.hiding, sizeof(nonces[index]->commitments.hiding));
        log_hex("Nonce binding commitment", nonces[index]->commitments.binding, sizeof(nonces[index]->commitments.binding));

        /* Copying secp256k1_frost_nonce_commitment to a shared array across participants */
        memcpy(&signing_commitments[index], &(nonces[index]->commitments), sizeof(secp256k1_frost_nonce_commitment));
    }

    /* Instead of signing (possibly very long) messages directly, we sign a 32-byte hash of the message.
     * We use secp256k1_tagged_sha256 to create this hash.  */
    return_val = secp256k1_tagged_sha256(sign_verify_ctx, msg_hash, tag, sizeof(tag), msg, sizeof(msg));
    assert(return_val == 1);

    /* Signature Share:
     * At least EXAMPLE_MIN_PARTICIPANTS participants compute a signature share. These
     * signature shares will be then aggregated to compute a single FROST signature. */
    for (index = 0; index < EXAMPLE_MIN_PARTICIPANTS; index++) {
        /* The secp256k1_frost_sign function provides a simple interface for signing 32-byte messages
         * (which in our case is a hash of the actual message).
         * Besides the message (msg_hash in this case), the function requires the number of other signers,
         * the private signer keypair and nonce, and the public signing commitments of other participants.
         */
        return_val = secp256k1_frost_sign(&(signature_shares[index]), msg_hash, EXAMPLE_MIN_PARTICIPANTS,
                             &keypairs[index], nonces[index], signing_commitments);
        assert(return_val == 1);
    }

    /*** Aggregation ***/

    /* A single entity can aggregate all signature shares. Otherwise, each participant can collect
     * and aggregate all signature shares by the other participants to the signing protocol.
     * We assume participant with index = 0 is aggregating the signature shares to compute the
     * FROST signature. */
    return_val = secp256k1_frost_aggregate(sign_verify_ctx, signature, msg_hash,
        &keypairs[0], public_keys, signing_commitments,
        signature_shares, EXAMPLE_MIN_PARTICIPANTS);
    assert(return_val == 1);

    /*** Verification ***/
    /* Verify a signature. This will return 1 if it's valid and 0 if it's not. */
    is_signature_valid = secp256k1_frost_verify(sign_verify_ctx, signature, msg_hash, &keypairs[0].public_keys);

    LOG_INF("Is signature valid? %s", is_signature_valid ? "true" : "false");

    /* Log final values */
    log_hex("Group Public Key", keypairs[0].public_keys.group_public_key, sizeof(keypairs[0].public_keys.group_public_key));
    log_hex("Final Signature", signature, sizeof(signature));
}
```
