## CMakeLists.txt
```
# SPDX-License-Identifier: Apache-2.0

cmake_minimum_required(VERSION 3.20.0)
find_package(Zephyr REQUIRED HINTS $ENV{ZEPHYR_BASE})
project(receive_bluetooth)

target_sources(app PRIVATE src/main.c)
```

## prj.conf
```kconfig
CONFIG_BT=y
CONFIG_BT_DEVICE_NAME="Test beacon"
CONFIG_POWEROFF=y
CONFIG_PM=y
CONFIG_ENTROPY_GENERATOR=y
CONFIG_LOG=y
```

## src/main.c
```c
/* main.c - Application main entry point */

/*
 * Copyright (c) 2015-2016 Intel Corporation
 * Copyright (c) 2021 Linaro Limited
 *
 * SPDX-License-Identifier: Apache-2.0
 */

 #include <zephyr/types.h>
 #include <zephyr/device.h>
 #include <stddef.h>
 #include <zephyr/sys/printk.h>
 #include <zephyr/sys/util.h>
 #include <zephyr/sys/poweroff.h>
 
 #include <zephyr/bluetooth/bluetooth.h>
 #include <zephyr/bluetooth/hci.h>
 
 #define DEVICE_NAME CONFIG_BT_DEVICE_NAME
 #define DEVICE_NAME_LEN (sizeof(DEVICE_NAME) - 1)
 
 /*
  * Set Advertisement data. Based on the Eddystone specification:
  * https://github.com/google/eddystone/blob/master/protocol-specification.md
  * https://github.com/google/eddystone/tree/master/eddystone-url
  */
 static const struct bt_data ad[] = {
     BT_DATA_BYTES(BT_DATA_FLAGS, BT_LE_AD_NO_BREDR),
     BT_DATA_BYTES(BT_DATA_UUID16_ALL, 0xaa, 0xfe),
     BT_DATA_BYTES(BT_DATA_SVC_DATA16,
               0xaa, 0xfe, /* Eddystone UUID */
               0x10, /* Eddystone-URL frame type */
               0x00, /* Calibrated Tx power at 0m */
               0x00, /* URL Scheme Prefix http://www. */
               'z', 'e', 'p', 'h', 'y', 'r',
               'p', 'r', 'o', 'j', 'e', 'c', 't',
               0x08) /* .org */
 };
 
 /* Set Scan Response data */
 static const struct bt_data sd[] = {
     BT_DATA(BT_DATA_NAME_COMPLETE, DEVICE_NAME, DEVICE_NAME_LEN),
 };
 
 static void bt_ready(int err)
 {
     char addr_s[BT_ADDR_LE_STR_LEN];
     bt_addr_le_t addr = {0};
     size_t count = 1;
 
     if (err) {
         printk("Bluetooth init failed (err %d)\n", err);
         return;
     }
 
     printk("Bluetooth initialized\n");
 
     k_sleep(K_MSEC(500));
 
     /* Start advertising */
     err = bt_le_adv_start(BT_LE_ADV_NCONN_IDENTITY, ad, ARRAY_SIZE(ad),
                   sd, ARRAY_SIZE(sd));
     if (err) {
         printk("Advertising failed to start (err %d)\n", err);
         return;
     }
 
     /* For connectable advertising you would use
      * bt_le_oob_get_local().  For non-connectable non-identity
      * advertising an non-resolvable private address is used;
      * there is no API to retrieve that.
      */
 
     bt_id_get(&addr, &count);
     bt_addr_le_to_str(&addr, addr_s, sizeof(addr_s));
 
     printk("Beacon started, advertising as %s\n", addr_s);
 
     k_sleep(K_SECONDS(2));
 
     err = bt_le_adv_stop();
     if (err != 0) {
         printk("Advertising failed to stop: %d", err);
         return;
     }
 
     printk("Beacon stopped\n");
 
     k_sleep(K_SECONDS(1));
 
     /* Start advertising */
     err = bt_le_adv_start(BT_LE_ADV_NCONN_IDENTITY, ad, ARRAY_SIZE(ad),
                   sd, ARRAY_SIZE(sd));
     if (err) {
         printk("Advertising failed to start (err %d)\n", err);
         return;
     }
 
     printk("Beacon started\n");
 
     err = bt_le_adv_stop();
     if (err != 0) {
         printk("Advertising failed to stop: %d", err);
         return;
     }
 
     printk("Beacon stopped\n");
 }
 
 int main(void)
 {
     int err;
 
     printk("Starting Beacon Demo\n");
     /* Initialize the Bluetooth Subsystem */
     err = bt_enable(bt_ready);
     if (err) {
         printk("Bluetooth init failed (err %d)\n", err);
     }
 
     /* Give time to bt_ready sequence */
     k_sleep(K_SECONDS(6));
 
     printk("Bluetooth disable\n");
     err = bt_disable();
     if (err) {
         printk("Bluetooth disable failed (err %d)\n", err);
     }
 
     k_sleep(K_SECONDS(2));
 
     printk("Bluetooth restart\n");
     /* Initialize the Bluetooth Subsystem */
     err = bt_enable(bt_ready);
     if (err) {
         printk("Bluetooth init failed (err %d)\n", err);
     }
 
     /* Give time to bt_ready sequence */
     k_sleep(K_SECONDS(6));
 
     printk("Bluetooth disable\n");
     err = bt_disable();
     if (err) {
         printk("Bluetooth disable failed (err %d)\n", err);
     }
 
     printk("Powering off\n");
     sys_poweroff();
 
     return 0;
 }
```
